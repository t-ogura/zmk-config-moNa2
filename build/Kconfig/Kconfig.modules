## build/Kconfig/Kconfig.modules
```kconfig
menu "zmk-pmw3610-driver (/home/ogu/workspace/prospector/zmk-config-moNa2/zmk-pmw3610-driver)"
osource "/home/ogu/workspace/prospector/zmk-config-moNa2/zmk-pmw3610-driver/Kconfig"
config ZEPHYR_ZMK_PMW3610_DRIVER_MODULE
	bool
	default y
endmenu
menu "zmk-rgbled-widget (/home/ogu/workspace/prospector/zmk-config-moNa2/zmk-rgbled-widget)"
osource "/home/ogu/workspace/prospector/zmk-config-moNa2/zmk-rgbled-widget/Kconfig"
config ZEPHYR_ZMK_RGBLED_WIDGET_MODULE
	bool
	default y
endmenu
menu "zmk-layout-shift (/home/ogu/workspace/prospector/zmk-config-moNa2/zmk-layout-shift)"
osource "/home/ogu/workspace/prospector/zmk-config-moNa2/zmk-layout-shift/Kconfig"
config ZEPHYR_ZMK_LAYOUT_SHIFT_MODULE
	bool
	default y
endmenu
menu "nanopb (/home/ogu/workspace/prospector/zmk-config-moNa2/modules/lib/nanopb)"
osource "$(ZEPHYR_NANOPB_KCONFIG)"
config ZEPHYR_NANOPB_MODULE
	bool
	default y
endmenu
menu "acpica (/home/ogu/workspace/prospector/zmk-config-moNa2/modules/lib/acpica)"
osource "$(ZEPHYR_ACPICA_KCONFIG)"
config ZEPHYR_ACPICA_MODULE
	bool
	default y
endmenu
menu "canopennode (/home/ogu/workspace/prospector/zmk-config-moNa2/modules/lib/canopennode)"
osource "$(ZEPHYR_CANOPENNODE_KCONFIG)"
config ZEPHYR_CANOPENNODE_MODULE
	bool
	default y
endmenu
menu "cmsis (/home/ogu/workspace/prospector/zmk-config-moNa2/modules/hal/cmsis)"
osource "$(ZEPHYR_CMSIS_KCONFIG)"
config ZEPHYR_CMSIS_MODULE
	bool
	default y
endmenu
menu "cmsis-dsp (/home/ogu/workspace/prospector/zmk-config-moNa2/modules/lib/cmsis-dsp)"
osource "$(ZEPHYR_CMSIS_DSP_KCONFIG)"
config ZEPHYR_CMSIS_DSP_MODULE
	bool
	default y
endmenu
menu "cmsis-nn (/home/ogu/workspace/prospector/zmk-config-moNa2/modules/lib/cmsis-nn)"
osource "$(ZEPHYR_CMSIS_NN_KCONFIG)"
config ZEPHYR_CMSIS_NN_MODULE
	bool
	default y
endmenu
menu "fatfs (/home/ogu/workspace/prospector/zmk-config-moNa2/modules/fs/fatfs)"
osource "$(ZEPHYR_FATFS_KCONFIG)"
config ZEPHYR_FATFS_MODULE
	bool
	default y
endmenu
menu "hal_ambiq (/home/ogu/workspace/prospector/zmk-config-moNa2/modules/hal/ambiq)"
osource "$(ZEPHYR_HAL_AMBIQ_KCONFIG)"
config ZEPHYR_HAL_AMBIQ_MODULE
	bool
	default y
endmenu
menu "hal_espressif (/home/ogu/workspace/prospector/zmk-config-moNa2/modules/hal/espressif)"
osource "/home/ogu/workspace/prospector/zmk-config-moNa2/modules/hal/espressif/zephyr/Kconfig"
config ZEPHYR_HAL_ESPRESSIF_MODULE
	bool
	default y
endmenu
menu "hal_ethos_u (/home/ogu/workspace/prospector/zmk-config-moNa2/modules/hal/ethos_u)"
osource "$(ZEPHYR_HAL_ETHOS_U_KCONFIG)"
config ZEPHYR_HAL_ETHOS_U_MODULE
	bool
	default y
endmenu
menu "hal_gigadevice (/home/ogu/workspace/prospector/zmk-config-moNa2/modules/hal/gigadevice)"
osource "$(ZEPHYR_HAL_GIGADEVICE_KCONFIG)"
config ZEPHYR_HAL_GIGADEVICE_MODULE
	bool
	default y
endmenu
menu "hal_nordic (/home/ogu/workspace/prospector/zmk-config-moNa2/modules/hal/nordic)"
osource "$(ZEPHYR_HAL_NORDIC_KCONFIG)"
config ZEPHYR_HAL_NORDIC_MODULE
	bool
	default y
endmenu
menu "hal_rpi_pico (/home/ogu/workspace/prospector/zmk-config-moNa2/modules/hal/rpi_pico)"
osource "$(ZEPHYR_HAL_RPI_PICO_KCONFIG)"
config ZEPHYR_HAL_RPI_PICO_MODULE
	bool
	default y
endmenu
menu "hal_telink (/home/ogu/workspace/prospector/zmk-config-moNa2/modules/hal/telink)"
osource "/home/ogu/workspace/prospector/zmk-config-moNa2/modules/hal/telink/Kconfig"
config ZEPHYR_HAL_TELINK_MODULE
	bool
	default y
endmenu
menu "liblc3 (/home/ogu/workspace/prospector/zmk-config-moNa2/modules/lib/liblc3)"
osource "$(ZEPHYR_LIBLC3_KCONFIG)"
config ZEPHYR_LIBLC3_MODULE
	bool
	default y
endmenu
menu "littlefs (/home/ogu/workspace/prospector/zmk-config-moNa2/modules/fs/littlefs)"
osource "$(ZEPHYR_LITTLEFS_KCONFIG)"
config ZEPHYR_LITTLEFS_MODULE
	bool
	default y
endmenu
menu "lvgl (/home/ogu/workspace/prospector/zmk-config-moNa2/modules/lib/gui/lvgl)"
osource "/home/ogu/workspace/prospector/zmk-config-moNa2/modules/lib/gui/lvgl/Kconfig"
config ZEPHYR_LVGL_MODULE
	bool
	default y
endmenu
menu "mbedtls (/home/ogu/workspace/prospector/zmk-config-moNa2/modules/crypto/mbedtls)"
osource "$(ZEPHYR_MBEDTLS_KCONFIG)"
config ZEPHYR_MBEDTLS_MODULE
	bool
	default y
endmenu
menu "percepio (/home/ogu/workspace/prospector/zmk-config-moNa2/modules/debug/percepio)"
osource "/home/ogu/workspace/prospector/zmk-config-moNa2/modules/debug/percepio/zephyr/Kconfig"
config ZEPHYR_PERCEPIO_MODULE
	bool
	default y
endmenu
menu "picolibc (/home/ogu/workspace/prospector/zmk-config-moNa2/modules/lib/picolibc)"
osource "/home/ogu/workspace/prospector/zmk-config-moNa2/modules/lib/picolibc/zephyr/Kconfig"
config ZEPHYR_PICOLIBC_MODULE
	bool
	default y
endmenu
menu "segger (/home/ogu/workspace/prospector/zmk-config-moNa2/modules/debug/segger)"
osource "$(ZEPHYR_SEGGER_KCONFIG)"
config ZEPHYR_SEGGER_MODULE
	bool
	default y
endmenu
menu "trusted-firmware-a (/home/ogu/workspace/prospector/zmk-config-moNa2/modules/tee/tf-a/trusted-firmware-a)"
osource "$(ZEPHYR_TRUSTED_FIRMWARE_A_KCONFIG)"
config ZEPHYR_TRUSTED_FIRMWARE_A_MODULE
	bool
	default y
endmenu
menu "uoscore-uedhoc (/home/ogu/workspace/prospector/zmk-config-moNa2/modules/lib/uoscore-uedhoc)"
osource "$(ZEPHYR_UOSCORE_UEDHOC_KCONFIG)"
config ZEPHYR_UOSCORE_UEDHOC_MODULE
	bool
	default y
endmenu
menu "zcbor (/home/ogu/workspace/prospector/zmk-config-moNa2/modules/lib/zcbor)"
osource "$(ZEPHYR_ZCBOR_KCONFIG)"
config ZEPHYR_ZCBOR_MODULE
	bool
	default y
endmenu
menu "module (/home/ogu/workspace/prospector/zmk-config-moNa2/zmk/app/module)"
osource "/home/ogu/workspace/prospector/zmk-config-moNa2/zmk/app/module/Kconfig"
config ZEPHYR_MODULE_MODULE
	bool
	default y
endmenu
menu "prospector-zmk-module (/home/ogu/workspace/prospector/zmk-config-moNa2/prospector-zmk-module)"
osource "/home/ogu/workspace/prospector/zmk-config-moNa2/prospector-zmk-module/Kconfig"
config ZEPHYR_PROSPECTOR_ZMK_MODULE_MODULE
	bool
	default y
endmenu
```

## build/Kconfig/Kconfig.shield
```kconfig
osource "/home/ogu/workspace/prospector/zmk-config-moNa2/zmk-rgbled-widget/boards/shields/*/Kconfig.shield"
osource "/home/ogu/workspace/prospector/zmk-config-moNa2/prospector-zmk-module/boards/shields/*/Kconfig.shield"
osource "/home/ogu/workspace/prospector/zmk-config-moNa2/zmk/app/boards/shields/*/Kconfig.shield"
```

## build/Kconfig/Kconfig.shield.defconfig
```kconfig
osource "/home/ogu/workspace/prospector/zmk-config-moNa2/zmk-rgbled-widget/boards/shields/*/Kconfig.defconfig"
osource "/home/ogu/workspace/prospector/zmk-config-moNa2/prospector-zmk-module/boards/shields/*/Kconfig.defconfig"
osource "/home/ogu/workspace/prospector/zmk-config-moNa2/zmk/app/boards/shields/*/Kconfig.defconfig"
```

## config/boards/shields/moNa2/Kconfig.defconfig
```kconfig
if SHIELD_MONA2_DONGLE

config ZMK_KEYBOARD_NAME
    default "moNa2"

config ZMK_SPLIT_ROLE_CENTRAL
    default y

config ZMK_SPLIT_BLE_CENTRAL_PERIPHERALS
    default 2

endif

if SHIELD_MONA2_R

config ZMK_KEYBOARD_NAME
    default "moNa2_R"

config ZMK_SPLIT
    default y

endif

if SHIELD_MONA2_L

config ZMK_KEYBOARD_NAME
    default "moNa2_L"

config ZMK_SPLIT
    default y

endif

if SHIELD_MONA2_DONGLE || SHIELD_MONA2_L || SHIELD_MONA2_R

config ZMK_SPLIT
    default y

endif
```

## config/boards/shields/moNa2/Kconfig.shield
```kconfig
config SHIELD_MONA2_R
    def_bool $(shields_list_contains,moNa2_R)

config SHIELD_MONA2_L
    def_bool $(shields_list_contains,moNa2_L)

config SHIELD_MONA2_DONGLE
    def_bool $(shields_list_contains,moNa2_dongle)
```
